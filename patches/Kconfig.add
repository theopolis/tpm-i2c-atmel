## patches/Kconfig.add
```kconfig
config TCG_TIS_I2C_ATMEL
	tristate "TPM Interface Specification 1.2 (I2C - Atmel)"
	depends on I2C
	---help---
	  If you have an Atmel AT97SC3204T I2C TPM say Yes and it will be accessible
	  from within Linux.
	  To compile this driver as a module, choose M here; the module will be called
	  tpm_i2c_atmel.
```
